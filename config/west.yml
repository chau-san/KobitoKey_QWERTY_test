## config/west.yml
```yaml
manifest:
  remotes:
    - name: zmkfirmware
      url-base: https://github.com/zmkfirmware
    - name: badjeff
      url-base: https://github.com/badjeff
    - name: hsgw
      url-base: https://github.com/hsgw
    - name: caksoylar
      url-base: https://github.com/caksoylar
    - name: kot149
      url-base: https://github.com/kot149
    - name: te9no
      url-base: https://github.com/te9no
    - name: cormoran
      url-base: https://github.com/cormoran

  projects:
    # cormoran/zmk main+dya (Zephyr 4.1 and custom Studio RPC)
    - name: zmk
      remote: cormoran
      revision: e5c9b6915b56801193e359dd9bad4a167ce0d1b8
      import: app/west.yml

    - name: zmk-pmw3610-driver
      remote: badjeff
      revision: e970029b42f33613ca8f05baf311dc733cd5a390

    - name: zmk-feature-sensor_rotation
      remote: hsgw
      revision: e1a0186220ade99220d04dadf9735b758cfdf086

    - name: zmk-rgbled-widget
      remote: caksoylar
      revision: e6b467792a1dabef8cfa5c9fd26bfefc9c16662b

    - name: zmk-layout-shift
      remote: kot149
      revision: f9ea0302d2796b4dd2f8932cf8f2979bb2d8a558

    - name: zmk-input-processor-keybind
      remote: te9no
      revision: 10ad463f2e3c7a7dfb4b7cffd6bddd0e9e8b5bae

    - name: zmk-module-runtime-input-processor
      remote: cormoran
      revision: decf628d7ce5ed95b520c650824c28ea9de649c1

    - name: zmk-module-battery-history
      remote: cormoran
      revision: 307755dd2ad4d320e14de162e8e5ef018f29d929

    - name: zmk-module-ble-management
      remote: cormoran
      revision: 57738cc4fc6ba80e82a7ac57741a0339cb186cd4

    - name: zmk-module-settings-rpc
      remote: cormoran
      revision: 78f86df9e6c5edaf57bef3ccbd7f360cfdf49291

    - name: zmk-feature-custom-settings
      remote: cormoran
      revision: c6a7fef3a3be3d3ace5de9a4b0628c6418cd1f3f
    - name: zmk-feature-runtime-macro
      remote: cormoran
      revision: 38530962eb7061b60efcb98e84585cfb1f0cb6de
      import: true

    - name: zmk-feature-runtime-combo
      remote: cormoran
      revision: d9490e7b5d41c516221d131241009e81740efcee
      import: true

  self:
    path: config
```
